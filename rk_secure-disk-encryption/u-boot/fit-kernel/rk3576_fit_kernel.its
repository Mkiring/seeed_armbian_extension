## rk_secure-disk-encryption/u-boot/fit-kernel/rk3576_fit_kernel.its
```
/dts-v1/;
/ {
    description = "U-Boot FIT source file for Rockchip RK3576";

    images {
        fdt {
            data = /incbin/("@KERNEL_DTB@");
            type = "flat_dt";
            arch = "arm64";
            compression = "none";
            load = <0x48300000>;

            hash {
                algo = "sha256";
            };
        };

        kernel {
            data = /incbin/("@KERNEL_IMG@");
            type = "kernel";
            arch = "arm64";
            os = "linux";
            compression = "none";
            entry = <0x40400000>;
            load = <0x40400000>;

            hash {
                algo = "sha256";
            };
        };

        ramdisk {
            data = /incbin/("@RAMDISK_IMG@");
            type = "ramdisk";
            arch = "arm64";
            os = "linux";
            compression = "none";
            load = <0x4a200000>;

            hash {
                algo = "sha256";
            };
        };

        resource {
            data = /incbin/("@RESOURCE_IMG@");
            type = "multi";
            arch = "arm64";
            compression = "none";

            hash {
                algo = "sha256";
            };
        };
    };

    configurations {
        default = "conf";

        conf {
            rollback-index = <0x00>;
            fdt = "fdt";
            kernel = "kernel";
            ramdisk = "ramdisk";
            multi = "resource";
            description = "Rockchip RK3576 FIT Image";

            signature {
                algo = "sha256,rsa2048";
                padding = "pss";
                key-name-hint = "dev";
                sign-images = "fdt", "kernel", "ramdisk", "multi";
            };
        };
    };
};
```
